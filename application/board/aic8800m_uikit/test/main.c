/*****************************************************************************
 *   Copyright(C)2009-2022 by VSF Team                                       *
 *                                                                           *
 *  Licensed under the Apache License, Version 2.0 (the "License");          *
 *  you may not use this file except in compliance with the License.         *
 *  You may obtain a copy of the License at                                  *
 *                                                                           *
 *     http://www.apache.org/licenses/LICENSE-2.0                            *
 *                                                                           *
 *  Unless required by applicable law or agreed to in writing, software      *
 *  distributed under the License is distributed on an "AS IS" BASIS,        *
 *  WITHOUT WARRANTIES OR CONDITIONS OF ANY KIND, either express or implied. *
 *  See the License for the specific language governing permissions and      *
 *  limitations under the License.                                           *
 *                                                                           *
 ****************************************************************************/

/*
 * tester for aic8800m_uikit
 * Including i2c touch screen, spi screen, sdio tf card, audio, debug uart
 *  Squares will be refreshed on screen; on touch of screen, a square will be
 *  refreshed on the corresponding position; a single frequency audio will be
 *  played; TF card will be initialized and display the data of the first section;
 *  messages will be outputed on debug uart.
 *
 * Dependency:
 * Board:
 *   vsf_board.mmc & vsf_board.mmc_voltage & vsf_board.mmc_bus_width
 *   vsf_board.audio_dev
 *   vsf_board.display_dev
 * 
 * Submodule(except PLOOC):
 *   CMSIS(source/utilities/compiler/arm/3rd-party/CMSIS)
 *   AIC8800M_SDK_vsf(source/hal/driver/AIC/AIC8800/vendor)
 * 
 * VSF_USER_ENTRY runs in thead mode(VSF_OS_CFG_MAIN_MODE is VSF_OS_CFG_MAIN_MODE_THREAD).
 */

/*============================ INCLUDES ======================================*/

#define __VSF_SIMPLE_STREAM_CLASS_INHERIT__
#define __VSF_DISP_CLASS_INHERIT__
#include "vsf.h"
#include "vsf_board.h"

// for srand/rand
#include <stdlib.h>

/*============================ MACROS ========================================*/

#if VSF_USE_TRACE != ENABLED
#   error this demo depends on VSF_USE_TRACE, please enable it!
#endif

/*============================ MACROFIED FUNCTIONS ===========================*/
/*============================ TYPES =========================================*/
/*============================ GLOBAL VARIABLES ==============================*/
/*============================ LOCAL VARIABLES ===============================*/

//48K 16bit 2ch
#define PLAYBACK_SIZE (1536 * 4)
const uint8_t __playback_buf[PLAYBACK_SIZE] = {
    0xFF, 0xFF, 0x01, 0x00, 0xB7, 0x10, 0xB3, 0x10, 0x1E, 0x21, 0x24, 0x21, 0xFF, 0x30, 0xF8, 0x30,
    0xFE, 0x3F, 0x04, 0x40, 0xEC, 0x4D, 0xE9, 0x4D, 0x83, 0x5A, 0x84, 0x5A, 0x8C, 0x65, 0x8C, 0x65,
    0xDB, 0x6E, 0xDA, 0x6E, 0x40, 0x76, 0x42, 0x76, 0xA6, 0x7B, 0xA3, 0x7B, 0xE5, 0x7E, 0xE7, 0x7E,
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    0x00, 0xC0, 0x02, 0xC0, 0x04, 0xCF, 0x02, 0xCF, 0xE0, 0xDE, 0xE2, 0xDE, 0x49, 0xEF, 0x47, 0xEF,
};

static vsf_mem_stream_t __audio_stream = {
    VSF_MEM_STREAM_INIT((uint8_t *)__playback_buf, sizeof(__playback_buf))
};

/*============================ PROTOTYPES ====================================*/
/*============================ IMPLEMENTATION ================================*/

static void __audio_stream_evthandler(vsf_stream_t *stream, void *param, vsf_stream_evt_t evt)
{
    if (VSF_STREAM_ON_OUT == evt) {
        vsf_stream_write(stream, NULL, vsf_stream_get_free_size(stream));
    }
}

static void __disp_on_ready(vk_disp_t *disp)
{
    vsf_eda_post_evt((vsf_eda_t *)disp->ui_data, VSF_EVT_USER);
}

int VSF_USER_ENTRY(void)
{
    vsf_board_init();
    vsf_start_trace();
    vsf_trace_info("aic8800m_uikit tester\n");

    // output audio data
    vsf_stream_init(&__audio_stream.use_as__vsf_stream_t);
    vk_audio_init(vsf_board.audio_dev);
    vk_audio_start(vsf_board.audio_dev, 0, &__audio_stream.use_as__vsf_stream_t, &(vk_audio_format_t){
        .datatype.value     = VSF_AUDIO_DATA_TYPE_LEU16,
        .sample_rate        = 480,
        .channel_num        = 2,
    });

    __audio_stream.tx.evthandler = __audio_stream_evthandler;
    vsf_stream_connect_tx(&__audio_stream.use_as__vsf_stream_t);
    __audio_stream_evthandler(&__audio_stream.use_as__vsf_stream_t, NULL, VSF_STREAM_ON_OUT);
    vsf_trace_info("audio opened\n");

    // SDIO test
    static vk_mmc_mal_t __mmc_mal = {
        .drv                    = &vk_mmc_mal_drv,
        .hw_priority            = vsf_arch_prio_0,
        .working_clock_hz       = 50UL * 1000 * 1000,
    };
    __mmc_mal.mmc = vsf_board.mmc;
    __mmc_mal.voltage = vsf_board.mmc_voltage;
    __mmc_mal.bus_width = vsf_board.mmc_bus_width;

    static uint8_t __buffer[512];
    vsf_trace_info("mmc test\n");
    vk_mal_init(&__mmc_mal.use_as__vk_mal_t);
    if ((int)vsf_eda_get_return_value() < 0) {
        vsf_trace_error("fail to initialize tf card.\n");
        return -1;
    }
    vk_mal_read(&__mmc_mal.use_as__vk_mal_t, 0, 512, __buffer);
    if ((int)vsf_eda_get_return_value() < 0) {
        vsf_trace_error("fail to read the first section of tf card.\n");
        return -1;
    }
    vsf_trace_buffer(VSF_TRACE_INFO, __buffer, sizeof(__buffer));

    // reset display and touch screen
    vsf_gpio_set_output(&vsf_hw_gpio1, 1 << 7);
    vsf_gpio_clear(&vsf_hw_gpio1, 1 << 7);
    vsf_thread_delay_ms(20);
    vsf_gpio_set(&vsf_hw_gpio1, 1 << 7);
    vsf_thread_delay_ms(100);

    // display test
    uint16_t *framebuffer = vsf_heap_malloc(32 * 32 * sizeof(uint16_t));
    if (NULL == framebuffer) {
        vsf_trace_error("not enough heap for framebuffer.\n");
        return -1;
    }
    vsf_board.display_dev->ui_data = vsf_eda_get_cur();
    vsf_board.display_dev->ui_on_ready = __disp_on_ready;
    vsf_trace_info("init display\n");
    if (VSF_ERR_NONE != vk_disp_init(vsf_board.display_dev)) {
        vsf_trace_error("fail to initialize display.\n");
        return -1;
    }
    vsf_thread_wfe(VSF_EVT_USER);

    uint16_t color;
    vk_disp_area_t area;
    srand((unsigned int)vsf_systimer_get());
    while (1) {
        color = rand() & 0xFFFF;
        area.size.x = 32;
        area.size.y = 32;
        for (int i = 0; i < area.size.x * area.size.y; i++) {
            framebuffer[i] = color;
        }

        area.pos.x = rand() % vsf_disp_get_width(vsf_board.display_dev);
        area.pos.y = rand() % vsf_disp_get_height(vsf_board.display_dev);
        if (area.pos.x + area.size.x > vsf_board.display_dev->param.width) {
            area.size.x = vsf_board.display_dev->param.width - area.pos.x;
        }
        if (area.pos.y + area.size.y > vsf_board.display_dev->param.height) {
            area.size.y = vsf_board.display_dev->param.height - area.pos.y;
        }

        vk_disp_refresh(vsf_board.display_dev, &area, framebuffer);
        vsf_thread_wfe(VSF_EVT_USER);
    }
    return 0;
}